#include <dt-bindings/board/am335x-bbw-bbb-base.h>
#include <dt-bindings/pinctrl/am33xx.h>

&tscadc {
    status = "okay";
};

&am335x_adc {
    ti,adc-channels = <0 1 2 3 4 5 6 7>;
};


/* From https://gist.github.com/matthewmcneely/bf44655c74096ff96475 */
/* Check using /sys/bus/iio */
